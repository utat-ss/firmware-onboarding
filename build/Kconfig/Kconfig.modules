## build/Kconfig/Kconfig.modules
```kconfig
menu "libcsp (/Users/andyliu/Workspaces/UTAT_Space_Systems/Onboarding_Activity/modules/lib/libcsp)"
osource "/Users/andyliu/Workspaces/UTAT_Space_Systems/Onboarding_Activity/modules/lib/libcsp/contrib/zephyr/Kconfig"
config ZEPHYR_LIBCSP_MODULE
	bool
	default y
endmenu
menu "acpica (/Users/andyliu/Workspaces/UTAT_Space_Systems/Onboarding_Activity/modules/lib/acpica)"
osource "$(ZEPHYR_ACPICA_KCONFIG)"
config ZEPHYR_ACPICA_MODULE
	bool
	default y
endmenu
menu "cmsis (/Users/andyliu/Workspaces/UTAT_Space_Systems/Onboarding_Activity/modules/hal/cmsis)"
osource "$(ZEPHYR_CMSIS_KCONFIG)"
config ZEPHYR_CMSIS_MODULE
	bool
	default y
endmenu
menu "cmsis-dsp (/Users/andyliu/Workspaces/UTAT_Space_Systems/Onboarding_Activity/modules/lib/cmsis-dsp)"
osource "$(ZEPHYR_CMSIS_DSP_KCONFIG)"
config ZEPHYR_CMSIS_DSP_MODULE
	bool
	default y
endmenu
menu "cmsis-nn (/Users/andyliu/Workspaces/UTAT_Space_Systems/Onboarding_Activity/modules/lib/cmsis-nn)"
osource "$(ZEPHYR_CMSIS_NN_KCONFIG)"
config ZEPHYR_CMSIS_NN_MODULE
	bool
	default y
endmenu
menu "fatfs (/Users/andyliu/Workspaces/UTAT_Space_Systems/Onboarding_Activity/modules/fs/fatfs)"
osource "$(ZEPHYR_FATFS_KCONFIG)"
config ZEPHYR_FATFS_MODULE
	bool
	default y
endmenu
config ZEPHYR_ADI_MODULE
	bool
	default y
config ZEPHYR_ALTERA_MODULE
	bool
	default y
menu "hal_ambiq (/Users/andyliu/Workspaces/UTAT_Space_Systems/Onboarding_Activity/modules/hal/ambiq)"
osource "$(ZEPHYR_HAL_AMBIQ_KCONFIG)"
config ZEPHYR_HAL_AMBIQ_MODULE
	bool
	default y
endmenu
config ZEPHYR_ATMEL_MODULE
	bool
	default y
menu "hal_espressif (/Users/andyliu/Workspaces/UTAT_Space_Systems/Onboarding_Activity/modules/hal/espressif)"
osource "/Users/andyliu/Workspaces/UTAT_Space_Systems/Onboarding_Activity/modules/hal/espressif/zephyr/Kconfig"
config ZEPHYR_HAL_ESPRESSIF_MODULE
	bool
	default y

config ZEPHYR_HAL_ESPRESSIF_MODULE_BLOBS
	bool
endmenu
menu "hal_ethos_u (/Users/andyliu/Workspaces/UTAT_Space_Systems/Onboarding_Activity/modules/hal/ethos_u)"
osource "$(ZEPHYR_HAL_ETHOS_U_KCONFIG)"
config ZEPHYR_HAL_ETHOS_U_MODULE
	bool
	default y
endmenu
menu "hal_gigadevice (/Users/andyliu/Workspaces/UTAT_Space_Systems/Onboarding_Activity/modules/hal/gigadevice)"
osource "$(ZEPHYR_HAL_GIGADEVICE_KCONFIG)"
config ZEPHYR_HAL_GIGADEVICE_MODULE
	bool
	default y
endmenu
menu "hal_infineon (/Users/andyliu/Workspaces/UTAT_Space_Systems/Onboarding_Activity/modules/hal/infineon)"
osource "$(ZEPHYR_HAL_INFINEON_KCONFIG)"
config ZEPHYR_HAL_INFINEON_MODULE
	bool
	default y

config ZEPHYR_HAL_INFINEON_MODULE_BLOBS
	bool
endmenu
menu "hal_intel (/Users/andyliu/Workspaces/UTAT_Space_Systems/Onboarding_Activity/modules/hal/intel)"
osource "/Users/andyliu/Workspaces/UTAT_Space_Systems/Onboarding_Activity/modules/hal/intel/zephyr/Kconfig"
config ZEPHYR_HAL_INTEL_MODULE
	bool
	default y
endmenu
config ZEPHYR_MICROCHIP_MODULE
	bool
	default y
menu "hal_nordic (/Users/andyliu/Workspaces/UTAT_Space_Systems/Onboarding_Activity/modules/hal/nordic)"
osource "$(ZEPHYR_HAL_NORDIC_KCONFIG)"
config ZEPHYR_HAL_NORDIC_MODULE
	bool
	default y

config ZEPHYR_HAL_NORDIC_MODULE_BLOBS
	bool
endmenu
config ZEPHYR_NUVOTON_MODULE
	bool
	default y
menu "hal_nxp (/Users/andyliu/Workspaces/UTAT_Space_Systems/Onboarding_Activity/modules/hal/nxp)"
osource "$(ZEPHYR_HAL_NXP_KCONFIG)"
config ZEPHYR_HAL_NXP_MODULE
	bool
	default y

config ZEPHYR_HAL_NXP_MODULE_BLOBS
	bool
endmenu
config ZEPHYR_OPENISA_MODULE
	bool
	default y
config ZEPHYR_QUICKLOGIC_MODULE
	bool
	default y
config ZEPHYR_HAL_RENESAS_MODULE
	bool
	default y

config ZEPHYR_HAL_RENESAS_MODULE_BLOBS
	bool
menu "hal_rpi_pico (/Users/andyliu/Workspaces/UTAT_Space_Systems/Onboarding_Activity/modules/hal/rpi_pico)"
osource "$(ZEPHYR_HAL_RPI_PICO_KCONFIG)"
config ZEPHYR_HAL_RPI_PICO_MODULE
	bool
	default y
endmenu
menu "hal_silabs (/Users/andyliu/Workspaces/UTAT_Space_Systems/Onboarding_Activity/modules/hal/silabs)"
osource "$(ZEPHYR_HAL_SILABS_KCONFIG)"
config ZEPHYR_HAL_SILABS_MODULE
	bool
	default y

config ZEPHYR_HAL_SILABS_MODULE_BLOBS
	bool
endmenu
menu "hal_st (/Users/andyliu/Workspaces/UTAT_Space_Systems/Onboarding_Activity/modules/hal/st)"
osource "$(ZEPHYR_HAL_ST_KCONFIG)"
config ZEPHYR_HAL_ST_MODULE
	bool
	default y
endmenu
config ZEPHYR_HAL_STM32_MODULE
	bool
	default y

config ZEPHYR_HAL_STM32_MODULE_BLOBS
	bool
menu "hal_telink (/Users/andyliu/Workspaces/UTAT_Space_Systems/Onboarding_Activity/modules/hal/telink)"
osource "/Users/andyliu/Workspaces/UTAT_Space_Systems/Onboarding_Activity/modules/hal/telink/Kconfig"
config ZEPHYR_HAL_TELINK_MODULE
	bool
	default y
endmenu
config ZEPHYR_TI_MODULE
	bool
	default y
config ZEPHYR_HAL_WURTHELEKTRONIK_MODULE
	bool
	default y
config ZEPHYR_XTENSA_MODULE
	bool
	default y
menu "hostap (/Users/andyliu/Workspaces/UTAT_Space_Systems/Onboarding_Activity/modules/lib/hostap)"
osource "$(ZEPHYR_HOSTAP_KCONFIG)"
config ZEPHYR_HOSTAP_MODULE
	bool
	default y
endmenu
config ZEPHYR_LIBMETAL_MODULE
	bool
	default y
menu "liblc3 (/Users/andyliu/Workspaces/UTAT_Space_Systems/Onboarding_Activity/modules/lib/liblc3)"
osource "$(ZEPHYR_LIBLC3_KCONFIG)"
config ZEPHYR_LIBLC3_MODULE
	bool
	default y
endmenu
menu "littlefs (/Users/andyliu/Workspaces/UTAT_Space_Systems/Onboarding_Activity/modules/fs/littlefs)"
osource "$(ZEPHYR_LITTLEFS_KCONFIG)"
config ZEPHYR_LITTLEFS_MODULE
	bool
	default y
endmenu
menu "loramac-node (/Users/andyliu/Workspaces/UTAT_Space_Systems/Onboarding_Activity/modules/lib/loramac-node)"
osource "$(ZEPHYR_LORAMAC_NODE_KCONFIG)"
config ZEPHYR_LORAMAC_NODE_MODULE
	bool
	default y
endmenu
menu "lvgl (/Users/andyliu/Workspaces/UTAT_Space_Systems/Onboarding_Activity/modules/lib/gui/lvgl)"
osource "/Users/andyliu/Workspaces/UTAT_Space_Systems/Onboarding_Activity/modules/lib/gui/lvgl/Kconfig"
config ZEPHYR_LVGL_MODULE
	bool
	default y
endmenu
menu "mbedtls (/Users/andyliu/Workspaces/UTAT_Space_Systems/Onboarding_Activity/modules/crypto/mbedtls)"
osource "$(ZEPHYR_MBEDTLS_KCONFIG)"
config ZEPHYR_MBEDTLS_MODULE
	bool
	default y
endmenu
config ZEPHYR_MCUBOOT_MODULE
	bool
	default y
config ZEPHYR_MIPI_SYS_T_MODULE
	bool
	default y
config ZEPHYR_NRF_HW_MODELS_MODULE
	bool
	default y
config ZEPHYR_OPEN_AMP_MODULE
	bool
	default y
menu "openthread (/Users/andyliu/Workspaces/UTAT_Space_Systems/Onboarding_Activity/modules/lib/openthread)"
osource "$(ZEPHYR_OPENTHREAD_KCONFIG)"
config ZEPHYR_OPENTHREAD_MODULE
	bool
	default y
endmenu
menu "percepio (/Users/andyliu/Workspaces/UTAT_Space_Systems/Onboarding_Activity/modules/debug/percepio)"
osource "/Users/andyliu/Workspaces/UTAT_Space_Systems/Onboarding_Activity/modules/debug/percepio/zephyr/Kconfig"
config ZEPHYR_PERCEPIO_MODULE
	bool
	default y
endmenu
menu "picolibc (/Users/andyliu/Workspaces/UTAT_Space_Systems/Onboarding_Activity/modules/lib/picolibc)"
osource "/Users/andyliu/Workspaces/UTAT_Space_Systems/Onboarding_Activity/modules/lib/picolibc/zephyr/Kconfig"
config ZEPHYR_PICOLIBC_MODULE
	bool
	default y
endmenu
menu "segger (/Users/andyliu/Workspaces/UTAT_Space_Systems/Onboarding_Activity/modules/debug/segger)"
osource "$(ZEPHYR_SEGGER_KCONFIG)"
config ZEPHYR_SEGGER_MODULE
	bool
	default y
endmenu
config ZEPHYR_TINYCRYPT_MODULE
	bool
	default y
menu "trusted-firmware-m (/Users/andyliu/Workspaces/UTAT_Space_Systems/Onboarding_Activity/modules/tee/tf-m/trusted-firmware-m)"
osource "$(ZEPHYR_TRUSTED_FIRMWARE_M_KCONFIG)"
config ZEPHYR_TRUSTED_FIRMWARE_M_MODULE
	bool
	default y
endmenu
menu "trusted-firmware-a (/Users/andyliu/Workspaces/UTAT_Space_Systems/Onboarding_Activity/modules/tee/tf-a/trusted-firmware-a)"
osource "$(ZEPHYR_TRUSTED_FIRMWARE_A_KCONFIG)"
config ZEPHYR_TRUSTED_FIRMWARE_A_MODULE
	bool
	default y
endmenu
menu "uoscore-uedhoc (/Users/andyliu/Workspaces/UTAT_Space_Systems/Onboarding_Activity/modules/lib/uoscore-uedhoc)"
osource "$(ZEPHYR_UOSCORE_UEDHOC_KCONFIG)"
config ZEPHYR_UOSCORE_UEDHOC_MODULE
	bool
	default y
endmenu
menu "zcbor (/Users/andyliu/Workspaces/UTAT_Space_Systems/Onboarding_Activity/modules/lib/zcbor)"
osource "$(ZEPHYR_ZCBOR_KCONFIG)"
config ZEPHYR_ZCBOR_MODULE
	bool
	default y
endmenu
```

## build/Kconfig/arch/Kconfig
```kconfig
# Load Zephyr Arch Kconfig descriptions.
osource "/Users/andyliu/Workspaces/UTAT_Space_Systems/Onboarding_Activity/zephyr/arch/x86/Kconfig"
osource "/Users/andyliu/Workspaces/UTAT_Space_Systems/Onboarding_Activity/zephyr/arch/xtensa/Kconfig"
osource "/Users/andyliu/Workspaces/UTAT_Space_Systems/Onboarding_Activity/zephyr/arch/sparc/Kconfig"
osource "/Users/andyliu/Workspaces/UTAT_Space_Systems/Onboarding_Activity/zephyr/arch/riscv/Kconfig"
osource "/Users/andyliu/Workspaces/UTAT_Space_Systems/Onboarding_Activity/zephyr/arch/posix/Kconfig"
osource "/Users/andyliu/Workspaces/UTAT_Space_Systems/Onboarding_Activity/zephyr/arch/nios2/Kconfig"
osource "/Users/andyliu/Workspaces/UTAT_Space_Systems/Onboarding_Activity/zephyr/arch/mips/Kconfig"
osource "/Users/andyliu/Workspaces/UTAT_Space_Systems/Onboarding_Activity/zephyr/arch/arm64/Kconfig"
osource "/Users/andyliu/Workspaces/UTAT_Space_Systems/Onboarding_Activity/zephyr/arch/arm/Kconfig"
osource "/Users/andyliu/Workspaces/UTAT_Space_Systems/Onboarding_Activity/zephyr/arch/arc/Kconfig"
```

## build/Kconfig/boards/Kconfig
```kconfig
# Load Zephyr board Kconfig descriptions.
osource "/home/zaraa/zephyr/boards/native/native_posix/Kconfig"
```

## build/Kconfig/boards/Kconfig.defconfig
```kconfig
# Load Zephyr board defconfig descriptions.
osource "/Users/andyliu/Workspaces/UTAT_Space_Systems/Onboarding_Activity/zephyr/boards/st/nucleo_g431rb/Kconfig.defconfig"
```

## build/Kconfig/boards/Kconfig.native_posix
```kconfig
# Load board Kconfig descriptions.
osource "/home/zaraa/zephyr/boards/native/native_posix/Kconfig.native_posix"
```

## build/Kconfig/boards/Kconfig.nucleo_g431rb
```kconfig
# Load board Kconfig descriptions.
osource "/Users/andyliu/Workspaces/UTAT_Space_Systems/Onboarding_Activity/zephyr/boards/st/nucleo_g431rb/Kconfig.nucleo_g431rb"
```

## build/Kconfig/boards/Kconfig.sysbuild
```kconfig
# Load Sysbuild board Kconfig descriptions.
osource "/home/zaraa/zephyr/boards/native/native_posix/Kconfig.sysbuild"
```
