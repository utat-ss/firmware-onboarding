## build/Kconfig/soc/Kconfig
```kconfig
# Load Zephyr SoC Kconfig descriptions.
osource "/Users/andyliu/Workspaces/UTAT_Space_Systems/Onboarding_Activity/zephyr/soc/xlnx/zynqmp/Kconfig"
osource "/Users/andyliu/Workspaces/UTAT_Space_Systems/Onboarding_Activity/zephyr/soc/xlnx/zynq7000/Kconfig"
osource "/Users/andyliu/Workspaces/UTAT_Space_Systems/Onboarding_Activity/zephyr/soc/xen/Kconfig"
osource "/Users/andyliu/Workspaces/UTAT_Space_Systems/Onboarding_Activity/zephyr/soc/ti/simplelink/Kconfig"
osource "/Users/andyliu/Workspaces/UTAT_Space_Systems/Onboarding_Activity/zephyr/soc/ti/lm3s6965/Kconfig"
osource "/Users/andyliu/Workspaces/UTAT_Space_Systems/Onboarding_Activity/zephyr/soc/ti/k3/Kconfig"
osource "/Users/andyliu/Workspaces/UTAT_Space_Systems/Onboarding_Activity/zephyr/soc/telink/tlsr/Kconfig"
osource "/Users/andyliu/Workspaces/UTAT_Space_Systems/Onboarding_Activity/zephyr/soc/starfive/jh71xx/Kconfig"
osource "/Users/andyliu/Workspaces/UTAT_Space_Systems/Onboarding_Activity/zephyr/soc/st/stm32/Kconfig"
osource "/Users/andyliu/Workspaces/UTAT_Space_Systems/Onboarding_Activity/zephyr/soc/snps/qemu_arc/Kconfig"
osource "/Users/andyliu/Workspaces/UTAT_Space_Systems/Onboarding_Activity/zephyr/soc/snps/nsim/arc_v/Kconfig"
osource "/Users/andyliu/Workspaces/UTAT_Space_Systems/Onboarding_Activity/zephyr/soc/snps/nsim/arc_classic/Kconfig"
osource "/Users/andyliu/Workspaces/UTAT_Space_Systems/Onboarding_Activity/zephyr/soc/snps/hsdk4xd/Kconfig"
osource "/Users/andyliu/Workspaces/UTAT_Space_Systems/Onboarding_Activity/zephyr/soc/snps/hsdk/Kconfig"
osource "/Users/andyliu/Workspaces/UTAT_Space_Systems/Onboarding_Activity/zephyr/soc/snps/emsk/Kconfig"
osource "/Users/andyliu/Workspaces/UTAT_Space_Systems/Onboarding_Activity/zephyr/soc/snps/emsdp/Kconfig"
osource "/Users/andyliu/Workspaces/UTAT_Space_Systems/Onboarding_Activity/zephyr/soc/snps/arc_iot/Kconfig"
osource "/Users/andyliu/Workspaces/UTAT_Space_Systems/Onboarding_Activity/zephyr/soc/silabs/Kconfig"
osource "/Users/andyliu/Workspaces/UTAT_Space_Systems/Onboarding_Activity/zephyr/soc/sifive/sifive_freedom/Kconfig"
osource "/Users/andyliu/Workspaces/UTAT_Space_Systems/Onboarding_Activity/zephyr/soc/sensry/Kconfig"
osource "/Users/andyliu/Workspaces/UTAT_Space_Systems/Onboarding_Activity/zephyr/soc/rockchip/Kconfig"
osource "/Users/andyliu/Workspaces/UTAT_Space_Systems/Onboarding_Activity/zephyr/soc/renode/riscv_virtual/Kconfig"
osource "/Users/andyliu/Workspaces/UTAT_Space_Systems/Onboarding_Activity/zephyr/soc/renode/cortex_r8_virtual/Kconfig"
osource "/Users/andyliu/Workspaces/UTAT_Space_Systems/Onboarding_Activity/zephyr/soc/renesas/smartbond/Kconfig"
osource "/Users/andyliu/Workspaces/UTAT_Space_Systems/Onboarding_Activity/zephyr/soc/renesas/rzt2m/Kconfig"
osource "/Users/andyliu/Workspaces/UTAT_Space_Systems/Onboarding_Activity/zephyr/soc/renesas/rcar/Kconfig"
osource "/Users/andyliu/Workspaces/UTAT_Space_Systems/Onboarding_Activity/zephyr/soc/renesas/ra/Kconfig"
osource "/Users/andyliu/Workspaces/UTAT_Space_Systems/Onboarding_Activity/zephyr/soc/raspberrypi/Kconfig"
osource "/Users/andyliu/Workspaces/UTAT_Space_Systems/Onboarding_Activity/zephyr/soc/quicklogic/eos_s3/Kconfig"
osource "/Users/andyliu/Workspaces/UTAT_Space_Systems/Onboarding_Activity/zephyr/soc/qemu/virt_riscv/Kconfig"
osource "/Users/andyliu/Workspaces/UTAT_Space_Systems/Onboarding_Activity/zephyr/soc/qemu/malta/Kconfig"
osource "/Users/andyliu/Workspaces/UTAT_Space_Systems/Onboarding_Activity/zephyr/soc/openisa/rv32m1/Kconfig"
osource "/Users/andyliu/Workspaces/UTAT_Space_Systems/Onboarding_Activity/zephyr/soc/nxp/s32/Kconfig"
osource "/Users/andyliu/Workspaces/UTAT_Space_Systems/Onboarding_Activity/zephyr/soc/nxp/rw/Kconfig"
osource "/Users/andyliu/Workspaces/UTAT_Space_Systems/Onboarding_Activity/zephyr/soc/nxp/mcx/Kconfig"
osource "/Users/andyliu/Workspaces/UTAT_Space_Systems/Onboarding_Activity/zephyr/soc/nxp/lpc/Kconfig"
osource "/Users/andyliu/Workspaces/UTAT_Space_Systems/Onboarding_Activity/zephyr/soc/nxp/layerscape/Kconfig"
osource "/Users/andyliu/Workspaces/UTAT_Space_Systems/Onboarding_Activity/zephyr/soc/nxp/kinetis/Kconfig"
osource "/Users/andyliu/Workspaces/UTAT_Space_Systems/Onboarding_Activity/zephyr/soc/nxp/imxrt/Kconfig"
osource "/Users/andyliu/Workspaces/UTAT_Space_Systems/Onboarding_Activity/zephyr/soc/nxp/imx/Kconfig"
osource "/Users/andyliu/Workspaces/UTAT_Space_Systems/Onboarding_Activity/zephyr/soc/nuvoton/numicro/Kconfig"
osource "/Users/andyliu/Workspaces/UTAT_Space_Systems/Onboarding_Activity/zephyr/soc/nuvoton/numaker/Kconfig"
osource "/Users/andyliu/Workspaces/UTAT_Space_Systems/Onboarding_Activity/zephyr/soc/nuvoton/npcx/Kconfig"
osource "/Users/andyliu/Workspaces/UTAT_Space_Systems/Onboarding_Activity/zephyr/soc/nuvoton/npcm/Kconfig"
osource "/Users/andyliu/Workspaces/UTAT_Space_Systems/Onboarding_Activity/zephyr/soc/nordic/Kconfig"
osource "/Users/andyliu/Workspaces/UTAT_Space_Systems/Onboarding_Activity/zephyr/soc/neorv32/Kconfig"
osource "/Users/andyliu/Workspaces/UTAT_Space_Systems/Onboarding_Activity/zephyr/soc/native/inf_clock/Kconfig"
osource "/Users/andyliu/Workspaces/UTAT_Space_Systems/Onboarding_Activity/zephyr/soc/microchip/miv/Kconfig"
osource "/Users/andyliu/Workspaces/UTAT_Space_Systems/Onboarding_Activity/zephyr/soc/microchip/mec/Kconfig"
osource "/Users/andyliu/Workspaces/UTAT_Space_Systems/Onboarding_Activity/zephyr/soc/mediatek/mtk_adsp/Kconfig"
osource "/Users/andyliu/Workspaces/UTAT_Space_Systems/Onboarding_Activity/zephyr/soc/lowrisc/opentitan/Kconfig"
osource "/Users/andyliu/Workspaces/UTAT_Space_Systems/Onboarding_Activity/zephyr/soc/litex/litex_vexriscv/Kconfig"
osource "/Users/andyliu/Workspaces/UTAT_Space_Systems/Onboarding_Activity/zephyr/soc/ite/ec/Kconfig"
osource "/Users/andyliu/Workspaces/UTAT_Space_Systems/Onboarding_Activity/zephyr/soc/intel/raptor_lake/Kconfig"
osource "/Users/andyliu/Workspaces/UTAT_Space_Systems/Onboarding_Activity/zephyr/soc/intel/lakemont/Kconfig"
osource "/Users/andyliu/Workspaces/UTAT_Space_Systems/Onboarding_Activity/zephyr/soc/intel/intel_socfpga_std/Kconfig"
osource "/Users/andyliu/Workspaces/UTAT_Space_Systems/Onboarding_Activity/zephyr/soc/intel/intel_socfpga/Kconfig"
osource "/Users/andyliu/Workspaces/UTAT_Space_Systems/Onboarding_Activity/zephyr/soc/intel/intel_niosv/Kconfig"
osource "/Users/andyliu/Workspaces/UTAT_Space_Systems/Onboarding_Activity/zephyr/soc/intel/intel_ish/Kconfig"
osource "/Users/andyliu/Workspaces/UTAT_Space_Systems/Onboarding_Activity/zephyr/soc/intel/intel_adsp/Kconfig"
osource "/Users/andyliu/Workspaces/UTAT_Space_Systems/Onboarding_Activity/zephyr/soc/intel/elkhart_lake/Kconfig"
osource "/Users/andyliu/Workspaces/UTAT_Space_Systems/Onboarding_Activity/zephyr/soc/intel/atom/Kconfig"
osource "/Users/andyliu/Workspaces/UTAT_Space_Systems/Onboarding_Activity/zephyr/soc/intel/apollo_lake/Kconfig"
osource "/Users/andyliu/Workspaces/UTAT_Space_Systems/Onboarding_Activity/zephyr/soc/intel/alder_lake/Kconfig"
osource "/Users/andyliu/Workspaces/UTAT_Space_Systems/Onboarding_Activity/zephyr/soc/infineon/cat3/Kconfig"
osource "/Users/andyliu/Workspaces/UTAT_Space_Systems/Onboarding_Activity/zephyr/soc/infineon/cat1b/Kconfig"
osource "/Users/andyliu/Workspaces/UTAT_Space_Systems/Onboarding_Activity/zephyr/soc/infineon/cat1a/Kconfig"
osource "/Users/andyliu/Workspaces/UTAT_Space_Systems/Onboarding_Activity/zephyr/soc/gd/gd32/Kconfig"
osource "/Users/andyliu/Workspaces/UTAT_Space_Systems/Onboarding_Activity/zephyr/soc/gaisler/leon3/Kconfig"
osource "/Users/andyliu/Workspaces/UTAT_Space_Systems/Onboarding_Activity/zephyr/soc/gaisler/gr716a/Kconfig"
osource "/Users/andyliu/Workspaces/UTAT_Space_Systems/Onboarding_Activity/zephyr/soc/espressif/Kconfig"
osource "/Users/andyliu/Workspaces/UTAT_Space_Systems/Onboarding_Activity/zephyr/soc/ene/kb1200/Kconfig"
osource "/Users/andyliu/Workspaces/UTAT_Space_Systems/Onboarding_Activity/zephyr/soc/efinix/sapphire/Kconfig"
osource "/Users/andyliu/Workspaces/UTAT_Space_Systems/Onboarding_Activity/zephyr/soc/cdns/xtensa_sample_controller/Kconfig"
osource "/Users/andyliu/Workspaces/UTAT_Space_Systems/Onboarding_Activity/zephyr/soc/cdns/sample_controller32/Kconfig"
osource "/Users/andyliu/Workspaces/UTAT_Space_Systems/Onboarding_Activity/zephyr/soc/cdns/dc233c/Kconfig"
osource "/Users/andyliu/Workspaces/UTAT_Space_Systems/Onboarding_Activity/zephyr/soc/brcm/bcmvk/Kconfig"
osource "/Users/andyliu/Workspaces/UTAT_Space_Systems/Onboarding_Activity/zephyr/soc/brcm/bcm2712/Kconfig"
osource "/Users/andyliu/Workspaces/UTAT_Space_Systems/Onboarding_Activity/zephyr/soc/brcm/bcm2711/Kconfig"
osource "/Users/andyliu/Workspaces/UTAT_Space_Systems/Onboarding_Activity/zephyr/soc/atmel/sam0/Kconfig"
osource "/Users/andyliu/Workspaces/UTAT_Space_Systems/Onboarding_Activity/zephyr/soc/atmel/sam/Kconfig"
osource "/Users/andyliu/Workspaces/UTAT_Space_Systems/Onboarding_Activity/zephyr/soc/aspeed/Kconfig"
osource "/Users/andyliu/Workspaces/UTAT_Space_Systems/Onboarding_Activity/zephyr/soc/arm/Kconfig"
osource "/Users/andyliu/Workspaces/UTAT_Space_Systems/Onboarding_Activity/zephyr/soc/arm/beetle/Kconfig"
osource "/Users/andyliu/Workspaces/UTAT_Space_Systems/Onboarding_Activity/zephyr/soc/andestech/Kconfig"
osource "/Users/andyliu/Workspaces/UTAT_Space_Systems/Onboarding_Activity/zephyr/soc/ambiq/Kconfig"
osource "/Users/andyliu/Workspaces/UTAT_Space_Systems/Onboarding_Activity/zephyr/soc/altr/zephyr_nios2f/Kconfig"
osource "/Users/andyliu/Workspaces/UTAT_Space_Systems/Onboarding_Activity/zephyr/soc/altr/qemu_nios2/Kconfig"
osource "/Users/andyliu/Workspaces/UTAT_Space_Systems/Onboarding_Activity/zephyr/soc/adi/max32/Kconfig"
```
